## Client/west.yml
```yaml
#
# Copyright (c) 2022 Circuit Dojo LLC
#
# SPDX-License-Identifier: Apache-2.0
#

manifest:
  remotes:
    - name: zephyrproject
      url-base: https://github.com/zephyrproject-rtos
  projects:
    - name: zephyr
      repo-path: zephyr
      remote: zephyrproject
      revision: v3.4.0
      import:
        path-prefix: deps
  self:
    # This repository should be cloned to 
    path: Client
```

## Kconfig
```kconfig
#
# Copyright (c) 2022 Circuit Dojo LLC
#
# SPDX-License-Identifier: Apache-2.0
#

mainmenu "thesis/thesis-trial"

if DNS_RESOLVER

config DNS_SERVER_IP_ADDRESSES
	default y

config DNS_SERVER1
	default "1.1.1.1"

endif # DNS_RESOLVER

source "Kconfig.zephyr"
```

## Server/Kconfig
```kconfig
#
# Copyright (c) 2022 Circuit Dojo LLC
#
# SPDX-License-Identifier: Apache-2.0
#

mainmenu "thesis/Server"

config NET_SEND_WAIT_TIME
	int "Wait time between sent packets (in ms)"
	default 0
	help
	  By default the application will send a packet every 5000 milliseconds.
	  If set to 0, then the packets are sent as fast as possible, which
	  will stress test the network stack.

config NET_ENABLE_PACKET_DGRAM
	bool "Use AF_PACKET with SOCK_DGRAM"
	depends on NET_SOCKETS_PACKET_DGRAM
	default y
	help
	  This will strip Ethernet header from received packets
	  and insert Ethernet header to sent packets.

config NET_DESTINATION_ADDR
	string "Destination Ethernet MAC address"
	depends on NET_SOCKETS_PACKET_DGRAM
	default "fc:c2:3d:2f:2d:58"
	help
	  Where to send the Ethernet frames.

source "Kconfig.zephyr"
```
